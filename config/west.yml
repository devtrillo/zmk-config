## config/west.yml
```yaml
manifest:
  remotes:
    - name: zmkfirmware
      url-base: https://github.com/zmkfirmware
    - name: davidphilipbarr
      url-base: https://github.com/davidphilipbarr
  projects:
    - name: zmk
      remote: davidphilipbarr
      revision: cradio-v2
      import: app/west.yml
    - name: zmk
      remote: zmkfirmware
      revision: main
      import: app/west.yml
  self:
    path: config
```
